/*******************************************************************************************************************************//**
 *
 * @file		XX_xxxx.c
 * @brief		--Descripción del Módulo--
 * @date		04/11/2018
 * @author		Esteban Chiama
 *
 **********************************************************************************************************************************/

/***********************************************************************************************************************************
 *** INCLUDES
 **********************************************************************************************************************************/


#include "AP_ADC.h"


/***********************************************************************************************************************************
 *** DEFINES PRIVADOS AL MODULO
 **********************************************************************************************************************************/

/***********************************************************************************************************************************
 *** MACROS PRIVADAS AL MODULO
 **********************************************************************************************************************************/

/***********************************************************************************************************************************
 *** TIPOS DE DATOS PRIVADOS AL MODULO
 **********************************************************************************************************************************/

/***********************************************************************************************************************************
 *** TABLAS PRIVADAS AL MODULO
 **********************************************************************************************************************************/

/***********************************************************************************************************************************
 *** VARIABLES GLOBALES PUBLICAS
 **********************************************************************************************************************************/

/***********************************************************************************************************************************
 *** VARIABLES GLOBALES PRIVADAS AL MODULO
 **********************************************************************************************************************************/

/***********************************************************************************************************************************
 *** PROTOTIPO DE FUNCIONES PRIVADAS AL MODULO
 **********************************************************************************************************************************/

 /***********************************************************************************************************************************
 *** FUNCIONES PRIVADAS AL MODULO
 **********************************************************************************************************************************/

 /***********************************************************************************************************************************
 *** FUNCIONES GLOBALES AL MODULO
 **********************************************************************************************************************************/


void Preparar_y_Enviar( void ){

	uint8_t bufferStatus, flag_Enviar = 0;
	uint16_t MuestraEfectiva;

	bufferStatus = GetBufferStatus();
	if( bufferStatus ==  VECTORES_LLENOS ){
		if ( SIZE != 1 ) {
			MuestraEfectiva = Mediana_de_Buffer();
		}
		else {
			MuestraEfectiva = ADC_valor;
		}
		flag_Enviar = 1;
	}

	Enlistar();

	if( flag_Enviar == 1 ){
		// transmito la trama con una muestra
		EnviarMuestra( MuestraEfectiva );
	}

}


void EnviarMuestra( uint16_t MuestraEfectiva ) {

	U0_PushTx('#');
	U0_PushTx((uint8_t)((MuestraEfectiva>>8) & 0xF));		// envío primero los 4 bits más significativos
	U0_PushTx((uint8_t)(MuestraEfectiva & 0xFF));			// envío los 8 restantes
	U0_PushTx('$');

	return;
}
