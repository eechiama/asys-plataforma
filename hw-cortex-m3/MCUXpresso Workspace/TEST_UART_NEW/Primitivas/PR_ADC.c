/*******************************************************************************************************************************//**
 *
 * @file		DR_ADC.c
 * @brief		--Descripción del Módulo--
 * @date		04/11/2018
 * @author		Esteban Chiama
 *
 **********************************************************************************************************************************/

/***********************************************************************************************************************************
 *** INCLUDES
 **********************************************************************************************************************************/


#include "PR_ADC.h"


/***********************************************************************************************************************************
 *** DEFINES PRIVADOS AL MODULO
 **********************************************************************************************************************************/

/***********************************************************************************************************************************
 *** MACROS PRIVADAS AL MODULO
 **********************************************************************************************************************************/

/***********************************************************************************************************************************
 *** TIPOS DE DATOS PRIVADOS AL MODULO
 **********************************************************************************************************************************/

/***********************************************************************************************************************************
 *** TABLAS PRIVADAS AL MODULO
 **********************************************************************************************************************************/

/***********************************************************************************************************************************
 *** VARIABLES GLOBALES PUBLICAS
 **********************************************************************************************************************************/

/***********************************************************************************************************************************
 *** VARIABLES GLOBALES PRIVADAS AL MODULO
 **********************************************************************************************************************************/


volatile uint16_t BufferMuestras[SIZE];


static uint8_t inxBuffer = 0;


/***********************************************************************************************************************************
 *** PROTOTIPO DE FUNCIONES PRIVADAS AL MODULO
 **********************************************************************************************************************************/


void bubble(volatile uint16_t *vector, int size);


 /***********************************************************************************************************************************
 *** FUNCIONES PRIVADAS AL MODULO
 **********************************************************************************************************************************/


/* Funcion bubble, que ordena un vector de menor a mayor con el metodo de burbujeo.*/
void bubble(volatile uint16_t *vector, int size) {

	int aux; //para el swap.
	int i, j;

	for(j=0; j<size-1; j++)	{

		for(i=0; i<size-1-j; i++) {

			if(vector[i]>vector[i+1]) {
				aux = vector[i+1];
				vector[i+1] = vector[i];
				vector[i] = aux;
			}

		}

	}
}


 /***********************************************************************************************************************************
 *** FUNCIONES GLOBALES AL MODULO
 **********************************************************************************************************************************/


void ResetBuffer( void ){

	// Simplemente que se vuelva a escribir desde la posición 0
	inxBuffer = 0;

}


uint8_t GetBufferStatus(void){

	uint8_t bufferStatus = ENLISTANDO;

	if ( inxBuffer == SIZE ){
		inxBuffer = 0;
		bufferStatus = VECTORES_LLENOS;
	}

	return bufferStatus;
}


void Enlistar( void ){

	uint16_t sample = ADC_valor;

	BufferMuestras[inxBuffer] = sample;
	inxBuffer++;

}


uint16_t Mediana_de_Buffer( void ){

	uint16_t MuestraEfectiva;

	// Ordenamos el vector
	bubble(BufferMuestras,SIZE);

	// Calculamos la media
	MuestraEfectiva = ( BufferMuestras[(SIZE-1)/2] + BufferMuestras[SIZE/2] ) / 2;

	return MuestraEfectiva;
}
